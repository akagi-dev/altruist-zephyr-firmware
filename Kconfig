## tests/config/native_sim/testcase.yaml
```yaml
tests:
  altruist.wp04.config.native_sim:
    tags:
      - wp04
      - config
    platform_allow:
      - native_sim/native/64
    integration_platforms:
      - native_sim/native/64
```

## tests/crypto/identity_native_sim/testcase.yaml
```yaml
tests:
  altruist.wp06.identity.native_sim:
    tags:
      - crypto
      - identity
      - wp06
    platform_allow:
      - native_sim/native/64
    integration_platforms:
      - native_sim/native/64
```

## tests/crypto/native_sim/testcase.yaml
```yaml
tests:
  altruist.crypto.native_sim:
    tags:
      - crypto
      - identity
    platform_allow:
      - native_sim/native/64
    integration_platforms:
      - native_sim/native/64
```

## tests/identity/testcase.yaml
```yaml
tests:
  altruist.identity:
    filter: CONFIG_SECURE_STORAGE and not CONFIG_SECURE_STORAGE_ITS_STORE_IMPLEMENTATION_NONE
    extra_args: EXTRA_CONF_FILE=overlay-secure_storage.conf
    tags:
      - crypto
      - identity
    platform_allow:
      - native_sim/native/64
    integration_platforms:
      - native_sim/native/64
```

## tests/settings/native_sim/testcase.yaml
```yaml
tests:
  altruist.settings.native_sim:
    tags:
      - config
    platform_allow:
      - native_sim/native/64
    integration_platforms:
      - native_sim/native/64
```

## tests/smoke/native_sim/sample.yaml
```yaml
tests:
  altruist.wp01.smoke.native_sim:
    tags:
      - smoke
      - wp01
    platform_allow:
      - native_sim
    integration_platforms:
      - native_sim
    harness: console
    harness_config:
      type: one_line
      regex:
        - "ALTRUIST_SMOKE_OK"
```

## tests/smoke/native_sim/testcase.yaml
```yaml
tests:
  altruist.wp01.smoke.native_sim:
    tags:
      - smoke
      - wp01
    platform_allow:
      - native_sim/native/64
    integration_platforms:
      - native_sim/native/64
    harness: console
    harness_config:
      type: one_line
      regex:
        - "ALTRUIST_SMOKE_OK"
```

## twister-out/native_sim_native/host_gnu/altruist-zephyr-firmware/tests/smoke/native_sim/altruist.wp01.smoke.native_sim/Kconfig/Kconfig.modules
```kconfig
menu "altruist-zephyr-firmware (/home/runner/work/altruist-zephyr-firmware/altruist-zephyr-firmware)"
osource "/home/runner/work/altruist-zephyr-firmware/altruist-zephyr-firmware/Kconfig"
config ZEPHYR_ALTRUIST_ZEPHYR_FIRMWARE_MODULE
	bool
	default y
endmenu
menu "cmsis (/home/runner/work/altruist-zephyr-firmware/modules/hal/cmsis)"
osource "$(ZEPHYR_CMSIS_KCONFIG)"
config ZEPHYR_CMSIS_MODULE
	bool
	default y
endmenu
menu "hal_espressif (/home/runner/work/altruist-zephyr-firmware/modules/hal/espressif)"
osource "$(ZEPHYR_HAL_ESPRESSIF_KCONFIG)"
config ZEPHYR_HAL_ESPRESSIF_MODULE
	bool
	default y

config ZEPHYR_HAL_ESPRESSIF_MODULE_BLOBS
	bool
endmenu
config ZEPHYR_XTENSA_MODULE
	bool
	default y
```

## twister-out/native_sim_native/host_gnu/altruist-zephyr-firmware/tests/smoke/native_sim/altruist.wp01.smoke.native_sim/Kconfig/Kconfig.shield
```kconfig
osource "/home/runner/work/altruist-zephyr-firmware/altruist-zephyr-firmware/app/boards/shields/*/Kconfig.shield"
```

## twister-out/native_sim_native/host_gnu/altruist-zephyr-firmware/tests/smoke/native_sim/altruist.wp01.smoke.native_sim/Kconfig/Kconfig.sysbuild.modules
```kconfig
config ZEPHYR_ALTRUIST_ZEPHYR_FIRMWARE_MODULE
   bool
   default y
config ZEPHYR_CMSIS_MODULE
   bool
   default y
config ZEPHYR_HAL_ESPRESSIF_MODULE
   bool
   default y
config ZEPHYR_XTENSA_MODULE
   bool
   default y
```

## twister-out/native_sim_native/host_gnu/altruist-zephyr-firmware/tests/smoke/native_sim/altruist.wp01.smoke.native_sim/Kconfig/arch/Kconfig.tmp
```kconfig
# Load Zephyr Arch Kconfig descriptions.
osource "/home/runner/work/altruist-zephyr-firmware/zephyr/arch/rx/Kconfig"
osource "/home/runner/work/altruist-zephyr-firmware/zephyr/arch/x86/Kconfig"
osource "/home/runner/work/altruist-zephyr-firmware/zephyr/arch/xtensa/Kconfig"
osource "/home/runner/work/altruist-zephyr-firmware/zephyr/arch/sparc/Kconfig"
osource "/home/runner/work/altruist-zephyr-firmware/zephyr/arch/riscv/Kconfig"
osource "/home/runner/work/altruist-zephyr-firmware/zephyr/arch/posix/Kconfig"
osource "/home/runner/work/altruist-zephyr-firmware/zephyr/arch/openrisc/Kconfig"
osource "/home/runner/work/altruist-zephyr-firmware/zephyr/arch/mips/Kconfig"
osource "/home/runner/work/altruist-zephyr-firmware/zephyr/arch/arm64/Kconfig"
osource "/home/runner/work/altruist-zephyr-firmware/zephyr/arch/arm/Kconfig"
osource "/home/runner/work/altruist-zephyr-firmware/zephyr/arch/arc/Kconfig"
```

## twister-out/native_sim_native/host_gnu/altruist-zephyr-firmware/tests/smoke/native_sim/altruist.wp01.smoke.native_sim/Kconfig/boards/Kconfig.defconfig.tmp
```kconfig
# Load Zephyr board defconfig descriptions.
osource "/home/runner/work/altruist-zephyr-firmware/zephyr/boards/native/native_sim/Kconfig.defconfig"
```

## twister-out/native_sim_native/host_gnu/altruist-zephyr-firmware/tests/smoke/native_sim/altruist.wp01.smoke.native_sim/Kconfig/boards/Kconfig.native_sim
```kconfig
# Load board Kconfig descriptions.
osource "/home/runner/work/altruist-zephyr-firmware/zephyr/boards/native/native_sim/Kconfig.native_sim"
```

## twister-out/native_sim_native/host_gnu/altruist-zephyr-firmware/tests/smoke/native_sim/altruist.wp01.smoke.native_sim/Kconfig/boards/Kconfig.sysbuild
```kconfig
# Load Sysbuild board Kconfig descriptions.
osource "/home/runner/work/altruist-zephyr-firmware/zephyr/boards/native/native_sim/Kconfig.sysbuild"
```

## twister-out/native_sim_native/host_gnu/altruist-zephyr-firmware/tests/smoke/native_sim/altruist.wp01.smoke.native_sim/Kconfig/boards/Kconfig.tmp
```kconfig
# Load Zephyr board Kconfig descriptions.
osource "/home/runner/work/altruist-zephyr-firmware/zephyr/boards/native/native_sim/Kconfig"
```
