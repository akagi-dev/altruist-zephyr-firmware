## twister-out/native_sim_native/host_gnu/altruist-zephyr-firmware/tests/smoke/native_sim/altruist.wp01.smoke.native_sim/Kconfig/soc/Kconfig.tmp
```kconfig
# Load Zephyr SoC Kconfig descriptions.
osource "/home/runner/work/altruist-zephyr-firmware/zephyr/soc/xlnx/zynqmp/Kconfig"
osource "/home/runner/work/altruist-zephyr-firmware/zephyr/soc/xlnx/zynq7000/Kconfig"
osource "/home/runner/work/altruist-zephyr-firmware/zephyr/soc/xlnx/versalnet/Kconfig"
osource "/home/runner/work/altruist-zephyr-firmware/zephyr/soc/xlnx/versal2/Kconfig"
osource "/home/runner/work/altruist-zephyr-firmware/zephyr/soc/xlnx/versal/Kconfig"
osource "/home/runner/work/altruist-zephyr-firmware/zephyr/soc/xen/Kconfig"
osource "/home/runner/work/altruist-zephyr-firmware/zephyr/soc/wch/ch32v/Kconfig"
osource "/home/runner/work/altruist-zephyr-firmware/zephyr/soc/ti/simplelink/Kconfig"
osource "/home/runner/work/altruist-zephyr-firmware/zephyr/soc/ti/mspm0/Kconfig"
osource "/home/runner/work/altruist-zephyr-firmware/zephyr/soc/ti/lm3s6965/Kconfig"
osource "/home/runner/work/altruist-zephyr-firmware/zephyr/soc/ti/k3/Kconfig"
osource "/home/runner/work/altruist-zephyr-firmware/zephyr/soc/telink/tlsr/Kconfig"
osource "/home/runner/work/altruist-zephyr-firmware/zephyr/soc/syna/sr100/Kconfig"
osource "/home/runner/work/altruist-zephyr-firmware/zephyr/soc/starfive/jh71xx/Kconfig"
osource "/home/runner/work/altruist-zephyr-firmware/zephyr/soc/st/stm32/Kconfig"
osource "/home/runner/work/altruist-zephyr-firmware/zephyr/soc/snps/qemu_arc/Kconfig"
osource "/home/runner/work/altruist-zephyr-firmware/zephyr/soc/snps/nsim/arc_v/Kconfig"
osource "/home/runner/work/altruist-zephyr-firmware/zephyr/soc/snps/nsim/arc_classic/Kconfig"
osource "/home/runner/work/altruist-zephyr-firmware/zephyr/soc/snps/hsdk4xd/Kconfig"
osource "/home/runner/work/altruist-zephyr-firmware/zephyr/soc/snps/hsdk/Kconfig"
osource "/home/runner/work/altruist-zephyr-firmware/zephyr/soc/snps/emsk/Kconfig"
osource "/home/runner/work/altruist-zephyr-firmware/zephyr/soc/snps/emsdp/Kconfig"
osource "/home/runner/work/altruist-zephyr-firmware/zephyr/soc/snps/arc_iot/Kconfig"
osource "/home/runner/work/altruist-zephyr-firmware/zephyr/soc/silabs/Kconfig"
osource "/home/runner/work/altruist-zephyr-firmware/zephyr/soc/sifli/sf32/Kconfig"
osource "/home/runner/work/altruist-zephyr-firmware/zephyr/soc/sifive/sifive_freedom/Kconfig"
osource "/home/runner/work/altruist-zephyr-firmware/zephyr/soc/sensry/Kconfig"
osource "/home/runner/work/altruist-zephyr-firmware/zephyr/soc/rockchip/Kconfig"
osource "/home/runner/work/altruist-zephyr-firmware/zephyr/soc/renode/riscv_virtual/Kconfig"
osource "/home/runner/work/altruist-zephyr-firmware/zephyr/soc/renode/cortex_r8_virtual/Kconfig"
osource "/home/runner/work/altruist-zephyr-firmware/zephyr/soc/renesas/smartbond/Kconfig"
osource "/home/runner/work/altruist-zephyr-firmware/zephyr/soc/renesas/rz/Kconfig"
osource "/home/runner/work/altruist-zephyr-firmware/zephyr/soc/renesas/rx/Kconfig"
osource "/home/runner/work/altruist-zephyr-firmware/zephyr/soc/renesas/rcar/Kconfig"
osource "/home/runner/work/altruist-zephyr-firmware/zephyr/soc/renesas/ra/Kconfig"
osource "/home/runner/work/altruist-zephyr-firmware/zephyr/soc/realtek/fingerprint/Kconfig"
osource "/home/runner/work/altruist-zephyr-firmware/zephyr/soc/realtek/ec/Kconfig"
osource "/home/runner/work/altruist-zephyr-firmware/zephyr/soc/realtek/bee/Kconfig"
osource "/home/runner/work/altruist-zephyr-firmware/zephyr/soc/realtek/ameba/Kconfig"
osource "/home/runner/work/altruist-zephyr-firmware/zephyr/soc/raspberrypi/rpi_pico/Kconfig"
osource "/home/runner/work/altruist-zephyr-firmware/zephyr/soc/quicklogic/eos_s3/Kconfig"
osource "/home/runner/work/altruist-zephyr-firmware/zephyr/soc/qemu/virt_riscv/Kconfig"
osource "/home/runner/work/altruist-zephyr-firmware/zephyr/soc/qemu/or1k/Kconfig"
osource "/home/runner/work/altruist-zephyr-firmware/zephyr/soc/qemu/malta/Kconfig"
osource "/home/runner/work/altruist-zephyr-firmware/zephyr/soc/openisa/rv32m1/Kconfig"
osource "/home/runner/work/altruist-zephyr-firmware/zephyr/soc/openhwgroup/cva6/Kconfig"
osource "/home/runner/work/altruist-zephyr-firmware/zephyr/soc/oct/osd32mp15x/Kconfig"
osource "/home/runner/work/altruist-zephyr-firmware/zephyr/soc/nxp/s32/Kconfig"
osource "/home/runner/work/altruist-zephyr-firmware/zephyr/soc/nxp/rw/Kconfig"
osource "/home/runner/work/altruist-zephyr-firmware/zephyr/soc/nxp/mcx/Kconfig"
osource "/home/runner/work/altruist-zephyr-firmware/zephyr/soc/nxp/lpc/Kconfig"
osource "/home/runner/work/altruist-zephyr-firmware/zephyr/soc/nxp/layerscape/Kconfig"
osource "/home/runner/work/altruist-zephyr-firmware/zephyr/soc/nxp/kinetis/Kconfig"
osource "/home/runner/work/altruist-zephyr-firmware/zephyr/soc/nxp/imxrt/Kconfig"
osource "/home/runner/work/altruist-zephyr-firmware/zephyr/soc/nxp/imx/Kconfig"
osource "/home/runner/work/altruist-zephyr-firmware/zephyr/soc/nuvoton/numicro/Kconfig"
osource "/home/runner/work/altruist-zephyr-firmware/zephyr/soc/nuvoton/numaker/Kconfig"
osource "/home/runner/work/altruist-zephyr-firmware/zephyr/soc/nuvoton/npcx/Kconfig"
osource "/home/runner/work/altruist-zephyr-firmware/zephyr/soc/nuvoton/npcm/Kconfig"
osource "/home/runner/work/altruist-zephyr-firmware/zephyr/soc/nordic/Kconfig"
osource "/home/runner/work/altruist-zephyr-firmware/zephyr/soc/neorv32/Kconfig"
osource "/home/runner/work/altruist-zephyr-firmware/zephyr/soc/native/inf_clock/Kconfig"
osource "/home/runner/work/altruist-zephyr-firmware/zephyr/soc/microchip/sam/sama7/Kconfig"
osource "/home/runner/work/altruist-zephyr-firmware/zephyr/soc/microchip/sam/sam_d5x_e5x/Kconfig"
osource "/home/runner/work/altruist-zephyr-firmware/zephyr/soc/microchip/pic64/Kconfig"
osource "/home/runner/work/altruist-zephyr-firmware/zephyr/soc/microchip/pic32c/pic32cz_ca/Kconfig"
osource "/home/runner/work/altruist-zephyr-firmware/zephyr/soc/microchip/pic32c/pic32cx_sg/Kconfig"
osource "/home/runner/work/altruist-zephyr-firmware/zephyr/soc/microchip/pic32c/pic32cm_pl/Kconfig"
osource "/home/runner/work/altruist-zephyr-firmware/zephyr/soc/microchip/pic32c/pic32cm_jh/Kconfig"
osource "/home/runner/work/altruist-zephyr-firmware/zephyr/soc/microchip/miv/Kconfig"
osource "/home/runner/work/altruist-zephyr-firmware/zephyr/soc/microchip/mec/Kconfig"
osource "/home/runner/work/altruist-zephyr-firmware/zephyr/soc/mediatek/mt8xxx/Kconfig"
osource "/home/runner/work/altruist-zephyr-firmware/zephyr/soc/lowrisc/opentitan/Kconfig"
osource "/home/runner/work/altruist-zephyr-firmware/zephyr/soc/litex/litex_vexriscv/Kconfig"
osource "/home/runner/work/altruist-zephyr-firmware/zephyr/soc/ite/ec/Kconfig"
osource "/home/runner/work/altruist-zephyr-firmware/zephyr/soc/intel/wildcat_lake/Kconfig"
osource "/home/runner/work/altruist-zephyr-firmware/zephyr/soc/intel/raptor_lake/Kconfig"
osource "/home/runner/work/altruist-zephyr-firmware/zephyr/soc/intel/panther_lake/Kconfig"
osource "/home/runner/work/altruist-zephyr-firmware/zephyr/soc/intel/lakemont/Kconfig"
osource "/home/runner/work/altruist-zephyr-firmware/zephyr/soc/intel/intel_socfpga_std/Kconfig"
osource "/home/runner/work/altruist-zephyr-firmware/zephyr/soc/intel/intel_socfpga/Kconfig"
osource "/home/runner/work/altruist-zephyr-firmware/zephyr/soc/intel/intel_niosv/Kconfig"
osource "/home/runner/work/altruist-zephyr-firmware/zephyr/soc/intel/intel_ish/Kconfig"
osource "/home/runner/work/altruist-zephyr-firmware/zephyr/soc/intel/intel_adsp/Kconfig"
osource "/home/runner/work/altruist-zephyr-firmware/zephyr/soc/intel/elkhart_lake/Kconfig"
osource "/home/runner/work/altruist-zephyr-firmware/zephyr/soc/intel/atom/Kconfig"
osource "/home/runner/work/altruist-zephyr-firmware/zephyr/soc/intel/apollo_lake/Kconfig"
osource "/home/runner/work/altruist-zephyr-firmware/zephyr/soc/intel/alder_lake/Kconfig"
osource "/home/runner/work/altruist-zephyr-firmware/zephyr/soc/infineon/psoc4/Kconfig"
osource "/home/runner/work/altruist-zephyr-firmware/zephyr/soc/infineon/edge/Kconfig"
osource "/home/runner/work/altruist-zephyr-firmware/zephyr/soc/infineon/cat3/Kconfig"
osource "/home/runner/work/altruist-zephyr-firmware/zephyr/soc/infineon/cat1c/Kconfig"
osource "/home/runner/work/altruist-zephyr-firmware/zephyr/soc/infineon/cat1b/Kconfig"
osource "/home/runner/work/altruist-zephyr-firmware/zephyr/soc/infineon/cat1a/Kconfig"
osource "/home/runner/work/altruist-zephyr-firmware/zephyr/soc/gd/gd32/Kconfig"
osource "/home/runner/work/altruist-zephyr-firmware/zephyr/soc/gaisler/leon3/Kconfig"
osource "/home/runner/work/altruist-zephyr-firmware/zephyr/soc/gaisler/gr716a/Kconfig"
osource "/home/runner/work/altruist-zephyr-firmware/zephyr/soc/focaltech/Kconfig"
osource "/home/runner/work/altruist-zephyr-firmware/zephyr/soc/espressif/Kconfig"
osource "/home/runner/work/altruist-zephyr-firmware/zephyr/soc/ene/kb1200/Kconfig"
osource "/home/runner/work/altruist-zephyr-firmware/zephyr/soc/ene/kb106x/Kconfig"
osource "/home/runner/work/altruist-zephyr-firmware/zephyr/soc/elan/em32f967/Kconfig"
osource "/home/runner/work/altruist-zephyr-firmware/zephyr/soc/egis/Kconfig"
osource "/home/runner/work/altruist-zephyr-firmware/zephyr/soc/efinix/sapphire/Kconfig"
osource "/home/runner/work/altruist-zephyr-firmware/zephyr/soc/cdns/xtensa_sample_controller/Kconfig"
osource "/home/runner/work/altruist-zephyr-firmware/zephyr/soc/cdns/swerv/Kconfig"
osource "/home/runner/work/altruist-zephyr-firmware/zephyr/soc/cdns/sample_controller32/Kconfig"
osource "/home/runner/work/altruist-zephyr-firmware/zephyr/soc/cdns/dc233c/Kconfig"
osource "/home/runner/work/altruist-zephyr-firmware/zephyr/soc/brcm/bcmvk/Kconfig"
osource "/home/runner/work/altruist-zephyr-firmware/zephyr/soc/brcm/bcm2712/Kconfig"
osource "/home/runner/work/altruist-zephyr-firmware/zephyr/soc/brcm/bcm2711/Kconfig"
osource "/home/runner/work/altruist-zephyr-firmware/zephyr/soc/blackberry/qnxhv_vm/Kconfig"
osource "/home/runner/work/altruist-zephyr-firmware/zephyr/soc/bflb/Kconfig"
osource "/home/runner/work/altruist-zephyr-firmware/zephyr/soc/atmel/sam0/Kconfig"
osource "/home/runner/work/altruist-zephyr-firmware/zephyr/soc/atmel/sam/Kconfig"
osource "/home/runner/work/altruist-zephyr-firmware/zephyr/soc/aspeed/Kconfig"
osource "/home/runner/work/altruist-zephyr-firmware/zephyr/soc/arm/Kconfig"
osource "/home/runner/work/altruist-zephyr-firmware/zephyr/soc/arm/beetle/Kconfig"
osource "/home/runner/work/altruist-zephyr-firmware/zephyr/soc/antmicro/myra/Kconfig"
osource "/home/runner/work/altruist-zephyr-firmware/zephyr/soc/andestech/Kconfig"
osource "/home/runner/work/altruist-zephyr-firmware/zephyr/soc/amd/acp_6_0/Kconfig"
osource "/home/runner/work/altruist-zephyr-firmware/zephyr/soc/ambiq/Kconfig"
osource "/home/runner/work/altruist-zephyr-firmware/zephyr/soc/allwinner/sun8i_h3/Kconfig"
osource "/home/runner/work/altruist-zephyr-firmware/zephyr/soc/alif/ensemble/Kconfig"
osource "/home/runner/work/altruist-zephyr-firmware/zephyr/soc/aesc/Kconfig"
osource "/home/runner/work/altruist-zephyr-firmware/zephyr/soc/adi/max32/Kconfig"
```

## west.yml
```yaml
manifest:
  version: 0.13

  self:
    path: altruist-zephyr-firmware

  remotes:
    - name: zephyrproject-rtos
      url-base: https://github.com/zephyrproject-rtos

  projects:
    - name: zephyr
      remote: zephyrproject-rtos
      revision: v4.4.1
      import:
        name-allowlist:
          - cmsis
          - hal_espressif
          - hal_xtensa
```
